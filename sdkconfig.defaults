## sdkconfig.defaults
```kconfig
CONFIG_IDF_TARGET="esp32s3"
CONFIG_ESPTOOLPY_FLASHSIZE_8MB=y
CONFIG_ESP_DEFAULT_CPU_FREQ_MHZ_240=y
CONFIG_FREERTOS_HZ=1000
CONFIG_COMPILER_OPTIMIZATION_PERF=y
CONFIG_ESP_MAIN_TASK_STACK_SIZE=8192
CONFIG_ESP_CONSOLE_NONE=y
# CONFIG_ESP_CONSOLE_SECONDARY_USB_SERIAL_JTAG is not set
CONFIG_UAC_SPEAKER_CHANNEL_NUM=0
CONFIG_UAC_MIC_CHANNEL_NUM=1
CONFIG_UAC_SAMPLE_RATE=48000
CONFIG_UAC_BIT_RESOLUTION_16=y
CONFIG_UAC_MIC_INTERVAL_MS=4
CONFIG_UAC_SUPPORT_MACOS=y
CONFIG_UAC_TUSB_MANUFACTURER="DIY Instruments"
CONFIG_UAC_TUSB_PRODUCT="AtomS3R Shaker"
CONFIG_UAC_TUSB_SERIAL_NUM="SHAKER001"
CONFIG_UAC_TINYUSB_TASK_PRIORITY=10
CONFIG_UAC_TINYUSB_TASK_CORE=0
CONFIG_UAC_MIC_TASK_PRIORITY=8
CONFIG_UAC_MIC_TASK_CORE=0
```
